## prj.conf
```kconfig
#
# Copyright (c) 2020 Nordic Semiconductor ASA
#
# SPDX-License-Identifier: LicenseRef-Nordic-5-Clause
#

CONFIG_NCS_SAMPLES_DEFAULTS=y

CONFIG_DK_LIBRARY=y

CONFIG_NFC_T2T_NRFXLIB=y

CONFIG_NFC_NDEF=y
CONFIG_NFC_NDEF_MSG=y
CONFIG_NFC_NDEF_RECORD=y
CONFIG_NFC_NDEF_TEXT_RECORD=y
CONFIG_POWEROFF=y

CONFIG_ADC=y
```

## src/adc.c
```c
#include "adc.h"

int configure_adc(){
    for (size_t i = 0U; i < ARRAY_SIZE(adc_channels); i++) {
        if (!adc_is_ready_dt(&adc_channels[i])) {
            printk("ADC controller device %s not ready\n", adc_channels[i].dev->name);
            return -1;
        }

		err = adc_channel_setup_dt(&adc_channels[i]);
		if (err < 0) {
			printk("Could not setup channel #%d (%d)\n", i, err);
			return -1;
		}
    }
}

int read_adc(){
	for (size_t i = 0U; i < ARRAY_SIZE(adc_channels); i++) {
		int32_t value_mV;

		printk("ADC read - %s, channel %d: ", adc_channels[i].dev->name, adc_channels[i].channel_id);

		(void)adc_sequence_init_dt(&adc_channels[i], &sequence);

		err = adc_read(adc_channels[i].dev, &sequence);
		if (err < 0) {
			printk("Could not read (%d)\n", err);
			return -1;
		}
		/*
		 * If using differential mode, the 16 bit value
		 * in the ADC sample buffer should be a signed 2's
		 * complement value.
		 */
		if (adc_channels[i].channel_cfg.differential) {
			val_mv = (int32_t)((int16_t)buf);
		} else {
			val_mv = (int32_t)buf;
		}
		printk("%"PRId32, value_mV);
		err = adc_raw_to_millivolts_dt(&adc_channels[i],
					       &value_mV);
		/* conversion to mV may not be supported, skip if not */
		if (err < 0) {
			printk(" (value in mV not available)\n");
		} else {
			printk(" = %"PRId32" mV\n", value_mV);
		}
	}
}
```

## src/checkpoint.c
```c
#include "checkpoint.h"


int checkpoint_create() {
    const struct device *flash_dev = PARTITION_DEVICE;
	uint32_t i, offset;

    uint32_t checkpoint_data[CHECKPOINT_WORDS] = 0;
    get_program_state(checkpoint_data);

    for (i = 0U; i < ARRAY_SIZE(checkpoint_data); i++) {
		offset = PARTITION_OFFSET + (i << 2) + 1;
		printk("Writing %X at 0x%X\n", checkpoint_data[i], offset);
		if (flash_write(flash_dev, offset, &checkpoint_data[i], sizeof(uint32_t)) != 0) {
			printk("Flash write failed!\n");
			return -1;
		}
        printk("Wrote %X at address 0x%X\n", checkpoint_data[i], offset);
    }
}

int checkpoint_recover() {
    const struct device *flash_dev = PARTITION_DEVICE;
    uint32_t read_word = 0U;
	uint32_t i, offset;

    uint32_t checkpoint_data[CHECKPOINT_WORDS];

    for (i = 0U; i < ARRAY_SIZE(checkpoint_data); i++) {
		offset = PARTITION_OFFSET + (i << 2) + 1;
        printk("Reading 0x%X\n", offset);
		if (flash_read(flash_dev, offset, &read_word, sizeof(uint32_t)) != 0) {
			printk("Flash read failed!\n");
			return -1;
		}
		printk("Read %X, from address %X\n", read_word, offset);
        checkpoint_data[i] = read_word;
    }
}

int get_program_state(uint32_t * buf) { // Number of stored values needs to match CHECKPOINT_WORDS
    // Register data
    for (int i = 0; i <= 12; ++i) {
        __asm__ volatile("MOV %0, R%d\n": "=r" (buf[i]) : "r" (i) : );
    }
    __asm__ volatile("MRS %0, MSP\n": "=r" (buf[13]) : : );
    __asm__ volatile("MRS %0, PSP\n": "=r" (buf[14]) : : );
    __asm__ volatile("MRS %0, LR\n": "=r" (buf[15]) : : );
    __asm__ volatile("MRS %0, PC\n": "=r" (buf[16]) : : );

    // RAM data


    // I/O data

}

int set_program_state(uint32_t * buf) {
    // Register data
    for (int i = 0; i <= 12; ++i) {
        __asm__ volatile("MOV R%d, %0\n":  "r" (i) :"=r" (buf[i]) : );
    }
    __asm__ volatile("MRS MSP, %0\n": : "=r" (buf[13]) : );
    __asm__ volatile("MRS PSP, %0\n": : "=r" (buf[14]) : );
    __asm__ volatile("MRS LR, %0\n": : "=r" (buf[15]) : );
    __asm__ volatile("MRS PC, %0\n": : "=r" (buf[16]) : );

    // RAM data
    
    // I/O data
}

int save_ram_to_flash() {
    uint32_t *ram_start = &_sram_data_start;
    uint32_t *ram_end = &_sram_data_end;
    uint32_t ram_size = (uint32_t)ram_end - (uint32_t)ram_start;
    uint32_t offset = RAM_STORAGE_OFFSET; // Offset in flash where RAM data should be stored

    for (uint32_t *ram_ptr = ram_start; ram_ptr < ram_end; ram_ptr++, offset += sizeof(uint32_t)) {
        if (flash_write(flash_dev, offset, ram_ptr, sizeof(uint32_t)) != 0) {
            printk("Flash write failed at offset 0x%X\n", offset);
            return -1;
        }
    }
}

int retrieve_ram_from_flash() {
    uint32_t *ram_start = &_sram_data_start;
    uint32_t *ram_end = &_sram_data_end;
    uint32_t offset = RAM_STORAGE_OFFSET; // Offset in flash where RAM data is stored

    // Loop through the flash storage and restore it to RAM
    for (uint32_t *ram_ptr = ram_start; ram_ptr < ram_end; ram_ptr++, offset += sizeof(uint32_t)) {
        uint32_t read_value;
        if (flash_read(flash_dev, offset, &read_value, sizeof(uint32_t)) != 0) {
            printk("Flash read failed at offset 0x%X\n", offset);
            return -1; 
        }
        *ram_ptr = read_value; // Restore value to RAM
    }
}

int checkpoint_test_flash() {
    uint32_t before[CHECKPOINT_WORDS] = {0};
    get_program_state(before);
    checkpoint_create();
    checkpoint_recover();
    uint32_t after[CHECKPOINT_WORDS] = {0};
    get_program_state(after);
    if (before != after) {
        printk("Written data not the same as read data!");
    }
}
```

## src/checkpoint.h
```c
#include <zephyr/kernel.h>
#include <zephyr/drivers/flash.h>
#include <zephyr/storage/flash_map.h>
#include <zephyr/device.h>
#include <zephyr/devicetree.h>
#include <stdio.h>
#include <stdint.h>

#ifdef CONFIG_TRUSTED_EXECUTION_NONSECURE
#define PARTITION	slot1_ns_partition
#else
#define PARTITION	slot1_partition
#endif

#define PARTITION_OFFSET	FIXED_PARTITION_OFFSET(PARTITION)
#define PARTITION_DEVICE	FIXED_PARTITION_DEVICE(PARTITION)

#define FLASH_PAGE_SIZE   4096
#define CHECKPOINT_WORDS    17
#define RAM_STORAGE_OFFSET 

#define RAM_START   0x20000008
#define RAM_END     0x20008008 //vet ikke om dette er riktig

/**
 * @brief Creates checkpoint for current tasks.
 * 
 * @return int 
 */
int checkpoint_create();

/**
 * @brief Recovers checkpoint data form befor sleep/reset.
 * 
 * @return int 
 */
int checkpoint_recover();

/**
 * @brief Test if flash memory is behaving as expected.
 * 
 * @return int 
 */
int checkpoint_test_flash();

/**
 * @brief Get the program state and store to buffer
 * 
 * @param buf[out]
 * @return int 
 */
int get_program_state(uint32_t * buf);

/**
 * @brief Set the program state from values in buffer
 * 
 * @param buf[in] 
 * @return int 
 */
int set_program_state(uint32_t * buf);

int save_ram_to_flash();

int retrieve_ram_from_flash();
```
