## CMakeLists.txt
```
cmake_minimum_required(VERSION 3.20.0)
find_package(Zephyr REQUIRED HINTS $ENV{ZEPHYR_BASE})

project(interval_system)

FILE(GLOB app_sources src/*.c)
target_sources(app PRIVATE ${app_sources})
```

## prj.conf
```kconfig
CONFIG_NRFX_SAADC=y

CONFIG_STDOUT_CONSOLE=y
CONFIG_FLASH=y
CONFIG_FLASH_PAGE_LAYOUT=y
CONFIG_MPU_ALLOW_FLASH_WRITE=y
CONFIG_SOC_FLASH_NRF_EMULATE_ONE_BYTE_WRITE_ACCESS=y

CONFIG_POWEROFF=y
CONFIG_PM_DEVICE=y
CONFIG_PM_DEVICE_RUNTIME=y

CONFIG_NRFX_LPCOMP=y

# Configure Bluetooth
CONFIG_BT=y
CONFIG_BT_PERIPHERAL=y
CONFIG_BT_DEVICE_NAME="SAADC - Bluetooth"
CONFIG_BT_DEVICE_APPEARANCE=0
CONFIG_BT_MAX_CONN=1
CONFIG_BT_LL_SOFTDEVICE=y
CONFIG_BT_PERIPHERAL_PREF_MAX_INT=10
CONFIG_BT_PERIPHERAL_PREF_MIN_INT=6

CONFIG_FPU=y

CONFIG_LOG=n
```

## src/main.c
```c
#include <zephyr/kernel.h>
#include <zephyr/sys/poweroff.h>
#include "checkpoint.h"
#include "lpcomp.h"
#include "saadc.h"
#include "bt.h"
#include <zephyr/pm/state.h>
#include <zephyr/pm/device.h>
#include <zephyr/pm/pm.h>
#include <zephyr/pm/policy.h>
#include <zephyr/device.h>
#include <nrfx_glue.h>
#include <nrfx_gpiote.h>

//#define GPIO_PIN 15

const struct device *dev = DEVICE_DT_GET(DT_CHOSEN(zephyr_console));

device_state_t current_state = RECOVER;
device_state_t next_state = MEASURE;
uint16_t current_sample = 0;

// ----- MAC ADDRESS PRINT ----- //
//void print_device_address(){
//    uint8_t * device_address = (uint8_t *)NRF_FICR->DEVICEADDR;
//    if (NRF_FICR->DEVICEADDRTYPE & 0x01) {
//        // Public address
//        printf("Public MAC Address: ");
//    } else {
//        // Random static address
//        printf("Random Static MAC Address: ");
//    }
//
//    printf("%02X:%02X:%02X:%02X:%02X:%02X\n",
//       device_address[5], device_address[4],
//       device_address[3], device_address[2],
//       device_address[1], device_address[0]);
//}

int main(void) {
//---------------------- GPIO -----------------------//
//    nrfx_err_t err_code = nrfx_gpiote_init(3);
//    if (err_code != NRFX_SUCCESS){
//        printf("Error (0x%X)\n", err_code); 
//    }
//
//    nrfx_gpiote_output_config_t out_config = NRFX_GPIOTE_DEFAULT_OUTPUT_CONFIG;
//    
//    err_code = nrfx_gpiote_output_configure(GPIO_PIN, &out_config, NULL);
//    if (err_code != NRFX_SUCCESS){
//        printf("Error (0x%X)\n", err_code); 
//    }
//---------------------------------------------------//

    int err;

    err = bluetooth_init(&bluetooth_callbacks, &remote_service_callbacks);
    if (err) {
        printf("Couldn't initialize Bluetooth. err: %d\n", err);
    }

    while(1) {
        switch (current_state) {
            case MEASURE:
                saadc_measure();
                if (current_sample == NUM_SAMPLES){
                    current_sample = 0;
                    next_state = COMMUNICATE;
                    current_state = next_state;
                } else {
                    next_state = SLEEP;
                    current_state = next_state;
                }
                checkpoint_create();
                set_first_boot_flag();
                break;
            
            case COMMUNICATE:
                int time = 0;
                advertisment_init();
                while(!notif_flag && time < 10000){
                    k_sleep(K_MSEC(1));
                    time++;
                }
                communicate_handler();
                advertisment_uninit();
                checkpoint_create();
                next_state = SLEEP;
                current_state = next_state;
                break;
            
            case RECOVER:
                if (!check_first_boot()) {
                    checkpoint_recover();
                } else {
                    lpcomp_start_init();
                    while(!start_flag){
                        k_sleep(K_MSEC(1));
                    }
                    nrfx_lpcomp_uninit();
                }
                current_state = next_state;
                break;

            case SLEEP:
                printk("SLEEP\n");
                err = pm_device_action_run(dev, PM_DEVICE_ACTION_SUSPEND);
                if (err) {
                    printk("pm_device_action_run() failed (%d)\n", err);
                }

                k_sleep(K_SECONDS(10));

                err = pm_device_action_run(dev, PM_DEVICE_ACTION_RESUME);
                if (err) {
                    printk("pm_device_action_run() failed (%d)\n", err);
                }

                next_state = MEASURE;
                current_state = next_state;              
                break;
        }
    }
    return 0;
}
```

## src/bt.c
```c
#include "bt.h"
#include "saadc.h"

struct bt_conn *current_conn;

struct bt_conn_cb bluetooth_callbacks = {
	.connected 		= on_connected,
	.disconnected 	= on_disconnected,
};

struct bt_remote_service_cb remote_service_callbacks = {
    .notif_changed = on_notif_changed,
};

/* Callbacks */

void on_connected(struct bt_conn *conn, uint8_t err) {
	if(err) {
		printk("connection err: %d\n", err);
		return;
	}
	//printk("Connected.\n");
	current_conn = bt_conn_ref(conn);
}

void on_disconnected(struct bt_conn *conn, uint8_t reason) {
	//printf("Disconnected (reason: %d)\n", reason);
	if(current_conn) {
		bt_conn_unref(current_conn);
		current_conn = NULL;
	}
}

void on_notif_changed(enum bt_saadc_notifications_enabled status) {
    if (status == BT_SAADC_NOTIFICATIONS_ENABLED) {
        //printf("Notifications enabled\n");
        notif_flag = 1;
    } else {
        //printf("Notifications disabled\n");
        notif_flag = 0;
    }
}

void communicate_handler(void) {
    int err;
    communicate_pd += 1;

    if (!current_conn) {
        printf("No active connection to send notification.\n");
        return;
    }
    communicate_samples[0] = 0xFFFF;
    communicate_samples[1] = checkpoint_pd;
    communicate_samples[2] = recover_pd;
    communicate_samples[3] = measure_pd;
    communicate_samples[4] = communicate_pd;

    uint8_t data_to_send[10*sizeof(uint16_t)]; // changes to uint8_t to receive data in right order

    for (int i = 0; i < ((NUM_SAMPLES*SAMPLE_SIZE)/10 + (((NUM_SAMPLES*SAMPLE_SIZE)%10) ? 1 : 0)); ++i) {
        memset(data_to_send, 0, sizeof(data_to_send)); // Clear buffer
        for (int j = 0; j < 10; ++j) {
            memcpy(&data_to_send[j*sizeof(uint16_t)], &communicate_samples[(i*10)+j], sizeof(uint16_t));
        }

        err = send_saadc_notification(current_conn, data_to_send, sizeof(data_to_send));
        if (err) {
            printf("Failed to send SAADC notification (Error: %d)\n", err);
        }
    }
}

int advertisment_uninit(void) {
    if (current_conn) {
        int err = bt_conn_disconnect(current_conn, BT_HCI_ERR_REMOTE_USER_TERM_CONN);
        if (err) {
            printf("Disconnection failed (err %d)\n", err);
        }

        bt_conn_unref(current_conn);
        current_conn = NULL;
    }

    int err = bt_le_adv_stop();
    if (err) {
        printf("Stopping advertising failed (err %d)\n", err);
    }
    return err;
}
```

## src/checkpoint.c
```c
#include "checkpoint.h"
#include "saadc.h"

const struct device *flash_dev = PARTITION_DEVICE;
uint32_t checkpoint_data[CHECKPOINT_WORDS] = {0};
uint32_t first_boot_flag;

bool check_first_boot() {
    if (flash_read(flash_dev, FIRST_BOOT_FLAG_ADDR, &first_boot_flag, sizeof(first_boot_flag)) != 0) {
        printk("Flash read failed at first boot check.\n");
        return false;
    }
    if (first_boot_flag == FIRST_BOOT_FLAG_VALUE) {
        return false;
    } else {
        return true;
    }
    return false;
}

bool set_first_boot_flag() {
    uint32_t first_boot_flag_value = 0xA5A5A5A5;
    if (first_boot_flag != FIRST_BOOT_FLAG_VALUE) {
        if (flash_erase(flash_dev, FIRST_BOOT_FLAG_ADDR, FLASH_PAGE_SIZE) != 0) {
            printk("Flash erase failed during first boot flag set.\n");
            return false;
        }
        if (flash_write(flash_dev, FIRST_BOOT_FLAG_ADDR, &first_boot_flag_value, sizeof(FIRST_BOOT_FLAG_VALUE)) != 0) {
            printk("Flash write failed during first boot flag set.\n");
            return false;
        }
        printk("First boot detected and flag set.\n");
        return true;
    }
    return false;
}

int checkpoint_create() {
    printk("#### CREATING CHECKPOINT ###\n");
    checkpoint_pd += 1; // SIMPLIFIED SOLUTION
    get_program_state(checkpoint_data);

    uint32_t offset = PARTITION_OFFSET;
    if (flash_erase(flash_dev, offset, FLASH_PAGE_SIZE) != 0) {
        printk("Flash erase failed at offset 0x%X\n", offset);
        return -1;
    }

    for (uint32_t i = 0; i < CHECKPOINT_WORDS; i++) {
		if (flash_write(flash_dev, offset + (i * sizeof(uint32_t)), &checkpoint_data[i], sizeof(checkpoint_data[i])) != 0) {
			printk("Flash write failed at offset 0x%08X\n", offset + (i * sizeof(uint32_t)));
			return -1;
		}
    }
    //return save_ram_to_flash(); // FULL SOLUTION
    return 0; // SIMPLIFIED SOLUTION
}

int checkpoint_recover() {
    printk("#### RECOVERING CHECKPOINT ####\n");
    uint32_t offset = PARTITION_OFFSET;

    for (uint32_t i = 0; i < CHECKPOINT_WORDS; i++) {
		if (flash_read(flash_dev, offset + (i * sizeof(uint32_t)), &checkpoint_data[i], sizeof(checkpoint_data[i])) != 0) {
			printk("Flash read failed at offset 0x%08X\n", offset + (i * sizeof(uint32_t)));
			return -1;
		}
    }
    set_program_state(checkpoint_data);
    //return retrieve_ram_from_flash(); // FULL SOLUTION
    return 0; // SIMPLIFIED SOLUTION
}

void get_program_state(uint32_t * buf) { // Number of stored values needs to match CHECKPOINT_WORDS
    printk("#### GET PROGRAM STATE ####\n");

    buf[0] = next_state; 
    buf[1] = current_sample; 

    // --- PERFORMANCE DATA - SHOULD BE EXCLUDED FROM RESULTS --- //
    buf[2] = checkpoint_pd;
    buf[3] = recover_pd;
    buf[4] = communicate_pd;
    buf[5] = measure_pd;
    // ---------------------------------------------------------- //

    uint16_t data_index = 6; 
    for (int i = 0; i < NUM_SAMPLES*SAMPLE_SIZE; ++i) {
        buf[data_index] = communicate_samples[i];
        data_index += 1;
    }

    // FULL SOLUTION //
    //__asm__ volatile("MOV %0, R0" : "=r" (buf[0]) : : );
    //__asm__ volatile("MOV %0, R1" : "=r" (buf[1]) : : );
    //__asm__ volatile("MOV %0, R2" : "=r" (buf[2]) : : );
    //__asm__ volatile("MOV %0, R3" : "=r" (buf[3]) : : );
    //__asm__ volatile("MOV %0, R4" : "=r" (buf[4]) : : );
    //__asm__ volatile("MOV %0, R5" : "=r" (buf[5]) : : );
    //__asm__ volatile("MOV %0, R6" : "=r" (buf[6]) : : );
    //__asm__ volatile("MOV %0, R7" : "=r" (buf[7]) : : );
    //__asm__ volatile("MOV %0, R8" : "=r" (buf[8]) : : );
    //__asm__ volatile("MOV %0, R9" : "=r" (buf[9]) : : );
    //__asm__ volatile("MOV %0, R10" : "=r" (buf[10]) : : );
    //__asm__ volatile("MOV %0, R11" : "=r" (buf[11]) : : );
    //__asm__ volatile("MOV %0, R12" : "=r" (buf[12]) : : );

    //__asm__ volatile("MRS %0, MSP\n": "=r" (buf[13]) : : );
    //__asm__ volatile("MRS %0, PSP\n": "=r" (buf[14]) : : );
    //__asm__ volatile("MOV %0, LR\n": "=r" (buf[15]) : : );
    //__asm__ volatile("MOV %0, PC\n": "=r" (buf[16]) : : );
}

void set_program_state(uint32_t * buf) {
    printk("#### SET PROGRAM STATE ####\n");

    next_state = buf[0];
    current_sample = buf[1];
    //next_state = 0;
    //current_sample = 0;

    // --- PERFORMANCE DATA - SHOULD BE EXCLUDED FROM RESULTS --- //
    checkpoint_pd = buf[2];
    recover_pd = buf[3];
    communicate_pd = buf[4];
    measure_pd = buf[5];
    // ---------------------------------------------------------- //

    uint16_t data_index = 6;
    for (int i = 0; i < NUM_SAMPLES*SAMPLE_SIZE; ++i) {
        communicate_samples[i] = buf[data_index];
        data_index += 1;
    }

    recover_pd += 1; // SIMPLIFIED SOLUTION

    // FULL SOLUTION //
    //__asm__ volatile("MOV R0, %0" : : "r" (buf[0]) : );
    //__asm__ volatile("MOV R1, %0" : : "r" (buf[1]) : );
    //__asm__ volatile("MOV R2, %0" : : "r" (buf[2]) : );
    //__asm__ volatile("MOV R3, %0" : : "r" (buf[3]) : );
    //__asm__ volatile("MOV R4, %0" : : "r" (buf[4]) : );
    //__asm__ volatile("MOV R5, %0" : : "r" (buf[5]) : );
    //__asm__ volatile("MOV R6, %0" : : "r" (buf[6]) : );
    //__asm__ volatile("MOV R7, %0" : : "r" (buf[7]) : );
    //__asm__ volatile("MOV R8, %0" : : "r" (buf[8]) : );
    //__asm__ volatile("MOV R9, %0" : : "r" (buf[9]) : );
    //__asm__ volatile("MOV R10, %0" : : "r" (buf[10]) : );
    //__asm__ volatile("MOV R11, %0" : : "r" (buf[11]) : );
    //__asm__ volatile("MOV R12, %0" : : "r" (buf[12]) : );

    //__asm__ volatile("MSR MSP, %0\n": : "r" (buf[13]) : );
    //__asm__ volatile("MSR PSP, %0\n": : "r" (buf[14]) : ); // This recover does not work for nRF52840, sometimes?
    //__asm__ volatile("MOV LR, %0\n": : "r" (buf[15]) : ); // This recover does not work for nRF52832, sometimes?
    //__asm__ volatile("MOV PC, %0\n": : "r" (buf[16]) : );
}

int save_ram_to_flash() {
    printk("#### SAVE RAM TO FLASH ####\n");
    uint32_t offset = PARTITION_OFFSET + CHECKPOINT_WORDS * sizeof(uint32_t); 

    for (uint32_t *ram_ptr = (uint32_t *)RAM_START; ram_ptr < (uint32_t *)RAM_END; ram_ptr++) {
        if (offset % FLASH_PAGE_SIZE == 0) {
            if (flash_erase(flash_dev, offset, FLASH_PAGE_SIZE) != 0) {
                printk("Flash erase failed at offset 0x%08X\n", offset);
                return -1;
            }
        }
        if (flash_write(flash_dev, offset, ram_ptr, sizeof(uint32_t)) != 0) { 
            printk("Flash write failed at offset 0x%08X\n", offset);
            return -1;
        }
        offset += sizeof(uint32_t);
    }
    checkpoint_pd += 1;
    return 0;
}

int retrieve_ram_from_flash() {
    printk("#### RETRIVE RAM FROM FLASH ####\n");
    uint32_t offset = PARTITION_OFFSET + (CHECKPOINT_WORDS * sizeof(uint32_t)); 

    for (uint32_t *ram_ptr = (uint32_t *)RAM_START; ram_ptr < (uint32_t *)RAM_END; ram_ptr++) {
        uint32_t data;

        if (flash_read(flash_dev, offset, &data, sizeof(uint32_t)) != 0) {
            printk("Flash read failed at offset 0x%08X\n", offset);
            return -1;
        }
        *ram_ptr = data;
        offset += sizeof(uint32_t);
    }
    recover_pd += 1;
    return 0;
}
```

## src/lpcomp.c
```c
#include "lpcomp.h"
#include "saadc.h"

int start_flag = 0;

void lpcomp_event_handler(nrf_lpcomp_event_t event_type) {
    if (NRF_LPCOMP->EVENTS_UP == 1) {
        NRF_LPCOMP->EVENTS_UP = 0;
        start_flag = 1;
    }
    // Clear unused interrupt events in case 
    NRF_LPCOMP->EVENTS_CROSS = 0;
    NRF_LPCOMP->EVENTS_DOWN = 0;
    NRF_LPCOMP->EVENTS_READY = 0;
}

void lpcomp_start_init(void) {   
    //printk("#### LPCOMP WAKE UP INIT ####\n");
    
    nrfx_err_t err_code;

    IRQ_DIRECT_CONNECT(COMP_LPCOMP_IRQn, 4, lpcomp_event_handler, 0);

    nrfx_lpcomp_config_t config = NRFX_LPCOMP_DEFAULT_CONFIG(NRF_LPCOMP_INPUT_2); // Threshold 1.5V - AIN2 should be UART_RXD
    config.config.detection = NRF_LPCOMP_DETECT_UP;

    err_code = nrfx_lpcomp_init(&config, NULL);
    if (err_code != NRFX_SUCCESS){
        printf("Error (0x%X)\n", err_code); 
    }

    nrfx_lpcomp_enable();
}
```

## src/lpcomp.h
```c
#ifndef LPCOMP_H
#define LPCOMP_H

#include <nrfx_lpcomp.h>

/** @brief Initializes the LPCOMP component. **/
void lpcomp_wakeup_init(void);

/** @brief Handles LPCOMP events. **/
void lpcomp_event_handler(nrf_lpcomp_event_t event);

#endif
```

## src/remote.c
```c
#include "remote.h"

//static K_SEM_DEFINE(bt_init_ok, 0, 1);

#define DEVICE_NAME CONFIG_BT_DEVICE_NAME
#define DEVICE_NAME_LEN (sizeof(DEVICE_NAME)-1)

static struct bt_remote_service_cb remote_service_callbacks;
enum bt_saadc_notifications_enabled notifications_enabled;

static const struct bt_data ad[] = {
    BT_DATA_BYTES(BT_DATA_FLAGS, (BT_LE_AD_GENERAL | BT_LE_AD_NO_BREDR)),
    BT_DATA(BT_DATA_NAME_COMPLETE, DEVICE_NAME, DEVICE_NAME_LEN)
};

static const struct bt_data sd[] = {
    BT_DATA_BYTES(BT_DATA_UUID128_ALL, BT_UUID_REMOTE_SERV_VAL),
};

/* Declarations */
void saadc_chrc_ccc_cfg_changed(const struct bt_gatt_attr *attr, uint16_t value);

BT_GATT_SERVICE_DEFINE(remote_srv,
BT_GATT_PRIMARY_SERVICE(BT_UUID_REMOTE_SERVICE),
    BT_GATT_CHARACTERISTIC(BT_UUID_REMOTE_SAADC_CHRC,
                           BT_GATT_CHRC_NOTIFY, //BT_GATT_CHRC_READ | BT_GATT_CHRC_NOTIFY,
                           BT_GATT_PERM_READ,
                           NULL, NULL, NULL),//read_saadc_characteristic_cb, NULL, NULL),
    BT_GATT_CCC(saadc_chrc_ccc_cfg_changed, BT_GATT_PERM_READ | BT_GATT_PERM_WRITE),
);

/* Callbacks */

void saadc_chrc_ccc_cfg_changed(const struct bt_gatt_attr *attr, uint16_t value) {
    bool notif_enabled = (value == BT_GATT_CCC_NOTIFY);
    //printf("Notifications %s\n", notif_enabled? "enabled":"disabled");

    notifications_enabled = notif_enabled? BT_SAADC_NOTIFICATIONS_ENABLED:BT_SAADC_NOTIFICATIONS_DISABLED;

    if (remote_service_callbacks.notif_changed) {
        remote_service_callbacks.notif_changed(notifications_enabled);
    }
}

void bt_ready(int err) {
    if (err) {
        printk("Bluetooth initialization failed with error %d\n", err);
    } 
    //k_sem_give(&bt_init_ok);
}

void on_sent(struct bt_conn *conn, void *user_data) {
    ARG_UNUSED(user_data);
    //printf("Notification sent on connection %p\n", (void *)conn);
}

/* Remote controller functions */

int send_saadc_notification(struct bt_conn *conn, uint8_t *values, uint16_t length) {
    int err = 0;
    const struct bt_gatt_attr *attr = &remote_srv.attrs[2];
    err = bt_gatt_notify(conn, attr, values, length);
    return err;
}

int bluetooth_init(struct bt_conn_cb *bt_cb, struct bt_remote_service_cb *remote_cb) {
    int err;
    //printf("Initializing Bluetooth\n");

    if (bt_cb == NULL || remote_cb == NULL) {
        return NRFX_ERROR_NULL;
    }

    bt_conn_cb_register(bt_cb);
    remote_service_callbacks.notif_changed = remote_cb->notif_changed;

    err = bt_enable(bt_ready);
    if (err) {
        printk("bt_enable returned %d\n", err);
        return err;
    }

    //k_sem_take(&bt_init_ok, K_FOREVER);

    return err;
}

int advertisment_init(void) {
    //printf("INIT ADVERTISMENT\n");

    const struct bt_le_adv_param adv_param = {
        .options = BT_LE_ADV_OPT_CONNECTABLE | BT_LE_ADV_OPT_ONE_TIME,
        .interval_min = BT_GAP_ADV_FAST_INT_MAX_2,
        .interval_max = 0x0600,
    };

    int err = bt_le_adv_start(&adv_param, ad, ARRAY_SIZE(ad), sd, ARRAY_SIZE(sd));
    if (err){
        printf("couldn't start advertising (err = %d)\n", err);
        return err;
    }

    return err;
}
```

## src/saadc.h
```c
#ifndef SAADC_H
#define SAADC_H

#include <zephyr/kernel.h>
#include <stdio.h>
#include <stdbool.h>
#include <stdint.h>
#include <nrfx_saadc.h>
#include <nrfx_timer.h>

#define NUMBER_OF_CHANNELS 1

#define SLEEP_THRESHOLD 1000 // mV
#define WAKE_UP_THRESHOLD 1500 // mV
#define NUM_SAMPLES 10
#define SAMPLE_SIZE 10

typedef enum {
    MEASURE,
    COMMUNICATE,
    RECOVER,
    SLEEP,
} device_state_t;

extern device_state_t current_state;
extern device_state_t next_state;
extern uint16_t communicate_samples[NUM_SAMPLES*SAMPLE_SIZE];
extern uint16_t current_sample;
extern bool notif_flag;


void handle_error(nrfx_err_t error_code);

void saadc_init(void);

void saadc_measure(void);

#endif
```
