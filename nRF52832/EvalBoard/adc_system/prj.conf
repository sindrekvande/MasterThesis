## CMakeLists.txt
```
cmake_minimum_required(VERSION 3.20.0)
find_package(Zephyr REQUIRED HINTS $ENV{ZEPHYR_BASE})

project(adc_system)

FILE(GLOB app_sources src/*.c)
target_sources(app PRIVATE ${app_sources})
```

## prj.conf
```kconfig
CONFIG_NRFX_SAADC=y

CONFIG_STDOUT_CONSOLE=y
CONFIG_FLASH=y
CONFIG_FLASH_PAGE_LAYOUT=y
CONFIG_MPU_ALLOW_FLASH_WRITE=y
CONFIG_SOC_FLASH_NRF_EMULATE_ONE_BYTE_WRITE_ACCESS=y

CONFIG_POWEROFF=y
CONFIG_PM_DEVICE=y
CONFIG_PM_DEVICE_RUNTIME=y

# Configure Bluetooth
CONFIG_BT=y
CONFIG_BT_PERIPHERAL=y
CONFIG_BT_DEVICE_NAME="SAADC - Bluetooth"
CONFIG_BT_DEVICE_APPEARANCE=0
CONFIG_BT_MAX_CONN=1
CONFIG_BT_LL_SOFTDEVICE=y

CONFIG_FPU=y

CONFIG_LOG=n
```

## src/checkpoint.h
```c
#ifndef CHECKPOINT_H
#define CHECKPOINT_H

#include <zephyr/kernel.h>
#include <zephyr/drivers/flash.h>
#include <zephyr/storage/flash_map.h>
#include <zephyr/device.h>
#include <zephyr/devicetree.h>

#ifdef CONFIG_TRUSTED_EXECUTION_NONSECURE
#define PARTITION	slot1_ns_partition
#else
#define PARTITION	slot1_partition
#endif

#define PARTITION_OFFSET	FIXED_PARTITION_OFFSET(PARTITION)
#define PARTITION_DEVICE	FIXED_PARTITION_DEVICE(PARTITION)

#define FLASH_PAGE_SIZE     4096 
#define CHECKPOINT_WORDS    7+(NUM_SAMPLES*SAMPLE_SIZE) // Number of registers (FULL SOLUTION: 19)

#define RAM_START   0x20000000 
#define RAM_END     0x20000010

#define FIRST_BOOT_FLAG_ADDR 0x42000
//#define REBOOT_FLAG_ADDR 0x41000
#define FIRST_BOOT_FLAG_VALUE 0xA5A5A5A5
//#define REBOOT_FLAG_VALUE 0xA5A5A5A5

bool check_first_boot();
bool set_first_boot_flag();
//bool check_reboot();
//bool set_reboot_flag();

/**
 * @brief Creates checkpoint for current tasks.
 * 
 * @return int 
 */
int checkpoint_create();

/**
 * @brief Recovers checkpoint data form befor sleep/reset.
 * 
 * @return int 
 */
int checkpoint_recover();

/** @brief Test if flash memory is behaving as expected. **/
void checkpoint_test_flash();

/**
 * @brief Get the program state and store to buffer
 * 
 * @param buf[out]
 */
void get_program_state(uint32_t * buf);

/**
 * @brief Set the program state from values in buffer
 * 
 * @param buf[in] 
 */
void set_program_state(uint32_t * buf);

int save_ram_to_flash();

int retrieve_ram_from_flash();

#endif
```

## src/remote.c
```c
#include "remote.h"

//static K_SEM_DEFINE(bt_init_ok, 0, 1);

#define DEVICE_NAME CONFIG_BT_DEVICE_NAME
#define DEVICE_NAME_LEN (sizeof(DEVICE_NAME)-1)

static struct bt_remote_service_cb remote_service_callbacks;
enum bt_saadc_notifications_enabled notifications_enabled;

static const struct bt_data ad[] = {
    BT_DATA_BYTES(BT_DATA_FLAGS, (BT_LE_AD_GENERAL | BT_LE_AD_NO_BREDR)),
    BT_DATA(BT_DATA_NAME_COMPLETE, DEVICE_NAME, DEVICE_NAME_LEN)
};

static const struct bt_data sd[] = {
    BT_DATA_BYTES(BT_DATA_UUID128_ALL, BT_UUID_REMOTE_SERV_VAL),
};

/* Declarations */
void saadc_chrc_ccc_cfg_changed(const struct bt_gatt_attr *attr, uint16_t value);

BT_GATT_SERVICE_DEFINE(remote_srv,
BT_GATT_PRIMARY_SERVICE(BT_UUID_REMOTE_SERVICE),
    BT_GATT_CHARACTERISTIC(BT_UUID_REMOTE_SAADC_CHRC,
                           BT_GATT_CHRC_NOTIFY, //BT_GATT_CHRC_READ | BT_GATT_CHRC_NOTIFY,
                           BT_GATT_PERM_READ,
                           NULL, NULL, NULL),//read_saadc_characteristic_cb, NULL, NULL),
    BT_GATT_CCC(saadc_chrc_ccc_cfg_changed, BT_GATT_PERM_READ | BT_GATT_PERM_WRITE),
);

/* Callbacks */

void saadc_chrc_ccc_cfg_changed(const struct bt_gatt_attr *attr, uint16_t value) {
    bool notif_enabled = (value == BT_GATT_CCC_NOTIFY);
    //printk("Notifications %s\n", notif_enabled? "enabled":"disabled");

    notifications_enabled = notif_enabled? BT_SAADC_NOTIFICATIONS_ENABLED:BT_SAADC_NOTIFICATIONS_DISABLED;

    if (remote_service_callbacks.notif_changed) {
        remote_service_callbacks.notif_changed(notifications_enabled);
    }
}

void bt_ready(int err) {
    if (err) {
        printk("Bluetooth initialization failed with error %d\n", err);
    } 
    //k_sem_give(&bt_init_ok);
}

void on_sent(struct bt_conn *conn, void *user_data) {
    ARG_UNUSED(user_data);
    printk("Notification sent on connection %p\n", (void *)conn);
}

/* Remote controller functions */

int send_saadc_notification(struct bt_conn *conn, uint8_t *values, uint16_t length) {
    int err = 0;
    const struct bt_gatt_attr *attr = &remote_srv.attrs[2];
    err = bt_gatt_notify(conn, attr, values, length);
    //printk("Saadc notification sent\n");
    return err;
}

int bluetooth_init(struct bt_conn_cb *bt_cb, struct bt_remote_service_cb *remote_cb) {
    int err;
    printk("Initializing Bluetooth\n");

    if (bt_cb == NULL || remote_cb == NULL) {
        return NRFX_ERROR_NULL;
    }

    bt_conn_cb_register(bt_cb);
    remote_service_callbacks.notif_changed = remote_cb->notif_changed;

    err = bt_enable(bt_ready);
    if (err) {
        printk("bt_enable returned %d\n", err);
        return err;
    }

    //k_sem_take(&bt_init_ok, K_FOREVER);
    printk("Bluetooth initalized\n");
    return err;
}

int advertisment_init(void) {
    printk("Initalizing advertise\n");

    //bt_addr_le_t target_addr = {
    //    .type = BT_ADDR_LE_PUBLIC,
    //    .a = { .val = { 0xD8, 0x3A, 0xDD, 0x36, 0x11, 0x94 } } 
    //};

    const struct bt_le_adv_param adv_param = {
        .options = BT_LE_ADV_OPT_CONNECTABLE | BT_LE_ADV_OPT_ONE_TIME,
        .interval_min = BT_GAP_ADV_FAST_INT_MAX_2,
        .interval_max = 0x0600,
        //.peer = &target_addr,
    };

    int err = bt_le_adv_start(&adv_param, ad, ARRAY_SIZE(ad), sd, ARRAY_SIZE(sd));
    if (err){
        printk("couldn't start advertising (err = %d)\n", err);
        return err;
    }
    printk("Advertise initialized\n");
    return err;
}
```
