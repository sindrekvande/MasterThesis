## prj.conf
```kconfig
CONFIG_NRFX_SAADC=y

CONFIG_NRFX_TIMER0=y

CONFIG_STDOUT_CONSOLE=y
CONFIG_FLASH=y
CONFIG_FLASH_PAGE_LAYOUT=y
CONFIG_MPU_ALLOW_FLASH_WRITE=y
CONFIG_SOC_FLASH_NRF_EMULATE_ONE_BYTE_WRITE_ACCESS=y

CONFIG_POWEROFF=y

CONFIG_NRFX_LPCOMP=y

# Configure Bluetooth
CONFIG_BT=y
CONFIG_BT_PERIPHERAL=y
CONFIG_BT_DEVICE_NAME="SAADC - Bluetooth"
CONFIG_BT_DEVICE_APPEARANCE=0
CONFIG_BT_MAX_CONN=1
CONFIG_BT_LL_SOFTDEVICE=y

CONFIG_FPU=y
```

## nrf52dk_nrf52832.overlay
```dts
// To get started, press Ctrl+Space (or Option+Esc) to bring up the completion menu and view the available nodes.

// You can also use the buttons in the sidebar to perform actions on nodes.
// Actions currently available include:

// * Enabling / disabling the node
// * Adding the bus to a bus
// * Removing the node
// * Connecting ADC channels

// For more help, browse the DeviceTree documentation at https://docs.zephyrproject.org/latest/guides/dts/index.html
// You can also visit the nRF DeviceTree extension documentation at https://nrfconnect.github.io/vscode-nrf-connect/devicetree/nrfdevicetree.html

&comp {
    compatible = "nordic,nrf-lpcomp";
    status = "okay";
};
```

## src/main.c
```c
#include "checkpoint.h"
#include "saadc.h"
#include "lpcomp.h"
#include "bt.h"
#include <zephyr/sys/poweroff.h>
#include <zephyr/pm/state.h>
#include <zephyr/pm/device.h>
#include <zephyr/pm/pm.h>
#include <zephyr/pm/policy.h>
#include <zephyr/device.h>
#include <nrfx_glue.h>

const struct device *dev = DEVICE_DT_GET(DT_CHOSEN(zephyr_console));

device_state_t current_state = RECOVER;
device_state_t next_state = MEASURE;
uint32_t current_sample = 0;

int main(void) {
    int err;
   
    err = bluetooth_init(&bluetooth_callbacks, &remote_service_callbacks);
    if (err) {
        printf("Couldn't initialize Bluetooth. err: %d\n", err);
    }

    nrfx_lpcomp_uninit();

    while (1) {
        switch (current_state) {
            case MEASURE:
                saadc_measure();
                if (current_sample == 10){
                    next_state = COMMUNICATE;
                } else {
                    next_state = SLEEP;
                }
                saadc_storage_check();
                break;

            case COMMUNICATE:
                advertisment_init();
                k_sleep(K_SECONDS(5));      // Wait for bluetooth connection.
                communicate_handler();            // Send value if connnected
                advertisment_uninit();
                next_state = SLEEP;
                saadc_storage_check();
                break;
            
            case DEEP_SLEEP:
                checkpoint_create();
                lpcomp_wakeup_init();
                printf("DEEP SLEEP\n");
                sys_poweroff();
                break;
            
            case RECOVER:
                checkpoint_recover(); // Could have to comment out checkpoint_recover and trigger checkpoint_create to get bt working
                current_state = next_state;
                break;

            case SLEEP:
                err = pm_device_action_run(dev, PM_DEVICE_ACTION_SUSPEND);
                if (err) {
                    printk("pm_device_action_run() failed (%d)\n", err);
                }

                k_sleep(K_SECONDS(3));

                err = pm_device_action_run(dev, PM_DEVICE_ACTION_RESUME);
                if (err) {
                    printk("pm_device_action_run() failed (%d)\n", err);
                }

                current_state = MEASURE;
                break;
        }
    }
}
```

## src/bt.c
```c
#include "bt.h"

extern float measure_value;

struct bt_conn *current_conn;

struct bt_conn_cb bluetooth_callbacks = {
	.connected 		= on_connected,
	.disconnected 	= on_disconnected,
};

struct bt_remote_service_cb remote_service_callbacks = {
    .notif_changed = on_notif_changed,
};

/* Callbacks */

void on_connected(struct bt_conn *conn, uint8_t err) {
	if(err) {
		printf("connection err: %d\n", err);
		return;
	}
	printf("Connected.\n");
	current_conn = bt_conn_ref(conn);
}

void on_disconnected(struct bt_conn *conn, uint8_t reason) {
	printf("Disconnected (reason: %d)\n", reason);
	if(current_conn) {
		bt_conn_unref(current_conn);
		current_conn = NULL;
	}
}

void on_notif_changed(enum bt_saadc_notifications_enabled status) {
    if (status == BT_SAADC_NOTIFICATIONS_ENABLED) {
        printf("Notifications enabled\n");
    } else {
        printf("Notifications disabled\n");
    }
}

void saadc_handler(void) {
    int err;

    if (!current_conn) {
        printf("No active connection to send notification.\n");
        return;
    }

    measure_value = measure_value * 100;
    uint32_t measure_value_int = (uint32_t)measure_value;
    printf("Measured value to be sent: %d\n", measure_value_int);
    set_saadc_value(measure_value_int);
    err = send_saadc_notification(current_conn, measure_value_int, sizeof(measure_value_int));
    if (err) {
        printf("Failed to send SAADC notification (Error: %d)\n", err);
    }
}

int advertisment_uninit(void) {
    printf("UNINIT ADVERTISMENT\n");

    if (current_conn) {
        int err = bt_conn_disconnect(current_conn, BT_HCI_ERR_REMOTE_USER_TERM_CONN);
        if (err) {
            printf("Disconnection failed (err %d)\n", err);
        }

        bt_conn_unref(current_conn);
        current_conn = NULL;
    }

    int err = bt_le_adv_stop();
    if (err) {
        printf("Stopping advertising failed (err %d)\n", err);
    }
    return err;
}

void test_bt_service() {
    printf("Starting BT service test...\n");

    bluetooth_init(&bluetooth_callbacks, &remote_service_callbacks);
    advertisment_init();

    k_sleep(K_SECONDS(10));

    advertisment_uninit();
    printf("BT service test completed.\n");
}
```

## src/bt.h
```c
#ifndef BT_H
#define BT_H

#include "remote.h"

void on_connected(struct bt_conn *conn, uint8_t err);
void on_disconnected(struct bt_conn *conn, uint8_t reason);
void on_notif_changed(enum bt_saadc_notifications_enabled status);
void fill_saadc_values(void);
void communicate_handler(void);
int advertisment_uninit(void);

extern struct bt_conn_cb bluetooth_callbacks;
extern struct bt_remote_service_cb remote_service_callbacks;

#endif
```

## src/checkpoint.c
```c
#include "checkpoint.h"
#include "saadc.h"

const struct device *flash_dev = PARTITION_DEVICE;
uint32_t checkpoint_data[CHECKPOINT_WORDS] = {0};

int checkpoint_create() {
    printk("#### CREATING CHECKPOINT ###\n");
    get_program_state(checkpoint_data);

    uint32_t offset = PARTITION_OFFSET;
    if (flash_erase(flash_dev, offset, FLASH_PAGE_SIZE) != 0) {
        printk("Flash erase failed at offset 0x%X\n", offset);
        return -1;
    }

    for (uint32_t i = 0; i < CHECKPOINT_WORDS; i++) {
		if (flash_write(flash_dev, offset + (i * sizeof(uint32_t)), &checkpoint_data[i], sizeof(checkpoint_data[i])) != 0) {
			printk("Flash write failed at offset 0x%08X\n", offset + (i * sizeof(uint32_t)));
			return -1;
		}
        //printk("Wrote 0x%08X at address 0x%08X\n", checkpoint_data[i], offset + (i * sizeof(uint32_t)));
    }
    return save_ram_to_flash();
}

int checkpoint_recover() {
    printk("#### RECOVERING CHECKPOINT ####\n");
    uint32_t offset = PARTITION_OFFSET;

    for (uint32_t i = 0; i < CHECKPOINT_WORDS; i++) {
		if (flash_read(flash_dev, offset + (i * sizeof(uint32_t)), &checkpoint_data[i], sizeof(checkpoint_data[i])) != 0) {
			printk("Flash read failed at offset 0x%08X\n", offset + (i * sizeof(uint32_t)));
			return -1;
		}
		//printk("Read 0x%08X, from address 0x%08X\n", checkpoint_data[i], offset + (i * sizeof(uint32_t)));
    }
    set_program_state(checkpoint_data);
    return retrieve_ram_from_flash();
}

void get_program_state(uint32_t * buf) { // Number of stored values needs to match CHECKPOINT_WORDS
    printk("#### GET PROGRAM STATE ####\n");

    buf[17] = next_state;
    buf[18] = current_sample;

    __asm__ volatile("MOV %0, R0" : "=r" (buf[0]) : : );
    __asm__ volatile("MOV %0, R1" : "=r" (buf[1]) : : );
    __asm__ volatile("MOV %0, R2" : "=r" (buf[2]) : : );
    __asm__ volatile("MOV %0, R3" : "=r" (buf[3]) : : );
    __asm__ volatile("MOV %0, R4" : "=r" (buf[4]) : : );
    __asm__ volatile("MOV %0, R5" : "=r" (buf[5]) : : );
    __asm__ volatile("MOV %0, R6" : "=r" (buf[6]) : : );
    __asm__ volatile("MOV %0, R7" : "=r" (buf[7]) : : );
    __asm__ volatile("MOV %0, R8" : "=r" (buf[8]) : : );
    __asm__ volatile("MOV %0, R9" : "=r" (buf[9]) : : );
    __asm__ volatile("MOV %0, R10" : "=r" (buf[10]) : : );
    __asm__ volatile("MOV %0, R11" : "=r" (buf[11]) : : );
    __asm__ volatile("MOV %0, R12" : "=r" (buf[12]) : : );

    __asm__ volatile("MRS %0, MSP\n": "=r" (buf[13]) : : );
    __asm__ volatile("MRS %0, PSP\n": "=r" (buf[14]) : : );
    __asm__ volatile("MOV %0, LR\n": "=r" (buf[15]) : : );
    __asm__ volatile("MOV %0, PC\n": "=r" (buf[16]) : : );

    printk("CS get: %d\n", buf[18]);
}

void set_program_state(uint32_t * buf) {
    printk("#### SET PROGRAM STATE ####\n");

    next_state = buf[17];
    current_sample = buf[18]; // Could have to set current_sample to 0, if it is stuck over 10
    //next_state = 0;
    //current_sample = 0;

    __asm__ volatile("MOV R0, %0" : : "r" (buf[0]) : );
    __asm__ volatile("MOV R1, %0" : : "r" (buf[1]) : );
    __asm__ volatile("MOV R2, %0" : : "r" (buf[2]) : );
    __asm__ volatile("MOV R3, %0" : : "r" (buf[3]) : );
    __asm__ volatile("MOV R4, %0" : : "r" (buf[4]) : );
    __asm__ volatile("MOV R5, %0" : : "r" (buf[5]) : );
    __asm__ volatile("MOV R6, %0" : : "r" (buf[6]) : );
    __asm__ volatile("MOV R7, %0" : : "r" (buf[7]) : );
    __asm__ volatile("MOV R8, %0" : : "r" (buf[8]) : );
    __asm__ volatile("MOV R9, %0" : : "r" (buf[9]) : );
    __asm__ volatile("MOV R10, %0" : : "r" (buf[10]) : );
    __asm__ volatile("MOV R11, %0" : : "r" (buf[11]) : );
    __asm__ volatile("MOV R12, %0" : : "r" (buf[12]) : );

    __asm__ volatile("MSR MSP, %0\n": : "r" (buf[13]) : );
    __asm__ volatile("MSR PSP, %0\n": : "r" (buf[14]) : ); // This recover does not work for nRF52840, sometimes?
    __asm__ volatile("MOV LR, %0\n": : "r" (buf[15]) : ); // This recover does not work for nRF52832, sometimes?
    __asm__ volatile("MOV PC, %0\n": : "r" (buf[16]) : );
}

int save_ram_to_flash() {
    printk("#### SAVE RAM TO FLASH ####\n");
    uint32_t offset = PARTITION_OFFSET + CHECKPOINT_WORDS * sizeof(uint32_t); 

    for (uint32_t *ram_ptr = (uint32_t *)RAM_START; ram_ptr < (uint32_t *)RAM_END; ram_ptr++) {
        if (offset % FLASH_PAGE_SIZE == 0) {
            if (flash_erase(flash_dev, offset, FLASH_PAGE_SIZE) != 0) {
                printk("Flash erase failed at offset 0x%08X\n", offset);
                return -1;
            }
        }
        if (flash_write(flash_dev, offset, ram_ptr, sizeof(uint32_t)) != 0) { 
            printk("Flash write failed at offset 0x%08X\n", offset);
            return -1;
        }
        //printk("Wrote %d from RAM %p at FLASH 0x%08X\n", *ram_ptr, ram_ptr, offset);
        offset += sizeof(uint32_t);
    }
    return 0;
}

int retrieve_ram_from_flash() {
    printk("#### RETRIVE RAM FROM FLASH ####\n");
    uint32_t offset = PARTITION_OFFSET + (CHECKPOINT_WORDS * sizeof(uint32_t)); 

    for (uint32_t *ram_ptr = (uint32_t *)RAM_START; ram_ptr < (uint32_t *)RAM_END; ram_ptr++) {
        uint32_t data;

        if (flash_read(flash_dev, offset, &data, sizeof(uint32_t)) != 0) {
            printk("Flash read failed at offset 0x%08X\n", offset);
            return -1;
        }
        //printk("Read %d from FLASH 0x%08X to RAM %p\n", data, offset, ram_ptr);
        *ram_ptr = data; // Writing back to RAM doesnt work for all addresses
        offset += sizeof(uint32_t);
    }
    return 0;
}
```

## src/checkpoint.h
```c
#ifndef CHECKPOINT_H
#define CHECKPOINT_H

#include <zephyr/kernel.h>
#include <zephyr/drivers/flash.h>
#include <zephyr/storage/flash_map.h>
#include <zephyr/device.h>
#include <zephyr/devicetree.h>

#ifdef CONFIG_TRUSTED_EXECUTION_NONSECURE
#define PARTITION	slot1_ns_partition
#else
#define PARTITION	slot1_partition
#endif

#define PARTITION_OFFSET	FIXED_PARTITION_OFFSET(PARTITION)
#define PARTITION_DEVICE	FIXED_PARTITION_DEVICE(PARTITION)

#define FLASH_PAGE_SIZE     4096 // Correct
#define CHECKPOINT_WORDS    19+(NUM_SAMPLES*SAMPLE_SIZE) // Number of registers

#define RAM_START   0x20000000 // Correct
#define RAM_END     0x20000010

/**
 * @brief Creates checkpoint for current tasks.
 * 
 * @return int 
 */
int checkpoint_create();

/**
 * @brief Recovers checkpoint data form befor sleep/reset.
 * 
 * @return int 
 */
int checkpoint_recover();

/** @brief Test if flash memory is behaving as expected. **/
void checkpoint_test_flash();

/**
 * @brief Get the program state and store to buffer
 * 
 * @param buf[out]
 */
void get_program_state(uint32_t * buf);

/**
 * @brief Set the program state from values in buffer
 * 
 * @param buf[in] 
 */
void set_program_state(uint32_t * buf);

int save_ram_to_flash();

int retrieve_ram_from_flash();

#endif
```

## src/lpcomp.c
```c
#include "lpcomp.h"
#include "saadc.h"

void lpcomp_event_handler(nrf_lpcomp_event_t event_type) {
    if (NRF_LPCOMP->EVENTS_UP == 1) {
        printf("WAKE UP\n");
        NRF_LPCOMP->EVENTS_UP = 0;
        current_state = RECOVER;
    }
    // Clear unused interrupt events in case 
    NRF_LPCOMP->EVENTS_CROSS = 0;
    NRF_LPCOMP->EVENTS_DOWN = 0;
    NRF_LPCOMP->EVENTS_READY = 0;
}

void lpcomp_wakeup_init() {   
    printf("#### LPCOMP WAKEUP INIT ####\n");
    
    nrfx_err_t err_code;

    IRQ_DIRECT_CONNECT(COMP_LPCOMP_IRQn, 4, lpcomp_event_handler, 0);

    nrfx_lpcomp_config_t config = NRFX_LPCOMP_DEFAULT_CONFIG(NRF_LPCOMP_INPUT_1);
    config.config.detection = NRF_LPCOMP_DETECT_UP;

    err_code = nrfx_lpcomp_init(&config, NULL);
    if (err_code != NRFX_SUCCESS){
        printf("Error (0x%X)\n", err_code); 
    }

    nrfx_lpcomp_enable();
}
```

## src/lpcomp.h
```c
#include <zephyr/kernel.h>
#include <nrfx_lpcomp.h>

void lpcomp_event_handler(nrf_lpcomp_event_t event);

void lpcomp_wakeup_init(void);
```

## src/remote.c
```c
#include "remote.h"

static K_SEM_DEFINE(bt_init_ok, 0, 1);

#define DEVICE_NAME CONFIG_BT_DEVICE_NAME
#define DEVICE_NAME_LEN (sizeof(DEVICE_NAME)-1)

static uint32_t saadc_value = 0;
static struct bt_remote_service_cb remote_service_callbacks;
enum bt_saadc_notifications_enabled notifications_enabled;

static const struct bt_data ad[] = {
    BT_DATA_BYTES(BT_DATA_FLAGS, (BT_LE_AD_GENERAL | BT_LE_AD_NO_BREDR)),
    BT_DATA(BT_DATA_NAME_COMPLETE, DEVICE_NAME, DEVICE_NAME_LEN)
};

static const struct bt_data sd[] = {
    BT_DATA_BYTES(BT_DATA_UUID128_ALL, BT_UUID_REMOTE_SERV_VAL),
};

/* Declarations */
static ssize_t read_saadc_characteristic_cb(struct bt_conn *conn, const struct bt_gatt_attr *attr, void *buf, uint16_t len, uint16_t offset);
void saadc_chrc_ccc_cfg_changed(const struct bt_gatt_attr *attr, uint16_t value);

BT_GATT_SERVICE_DEFINE(remote_srv,
BT_GATT_PRIMARY_SERVICE(BT_UUID_REMOTE_SERVICE),
    BT_GATT_CHARACTERISTIC(BT_UUID_REMOTE_SAADC_CHRC,
                           BT_GATT_CHRC_READ | BT_GATT_CHRC_NOTIFY,
                           BT_GATT_PERM_READ,
                           read_saadc_characteristic_cb, NULL, NULL),
    BT_GATT_CCC(saadc_chrc_ccc_cfg_changed, BT_GATT_PERM_READ | BT_GATT_PERM_WRITE),
);

/* Callbacks */

void saadc_chrc_ccc_cfg_changed(const struct bt_gatt_attr *attr, uint16_t value) {
    bool notif_enabled = (value == BT_GATT_CCC_NOTIFY);
    printf("Notifications %s\n", notif_enabled? "enabled":"disabled");

    notifications_enabled = notif_enabled? BT_SAADC_NOTIFICATIONS_ENABLED:BT_SAADC_NOTIFICATIONS_DISABLED;

    if (remote_service_callbacks.notif_changed) {
        remote_service_callbacks.notif_changed(notifications_enabled);
    }
}

static ssize_t read_saadc_characteristic_cb(struct bt_conn *conn, const struct bt_gatt_attr *attr, void *buf, uint16_t len, uint16_t offset) {
    return bt_gatt_attr_read(conn, attr, buf, len, offset, &saadc_value, sizeof(saadc_value));
}

void bt_ready(int err) {
    if (err) {
        printf("Bluetooth initialization failed with error %d\n", err);
    } 
    k_sem_give(&bt_init_ok);
}

void on_sent(struct bt_conn *conn, void *user_data) {
    ARG_UNUSED(user_data);
    printf("Notification sent on connection %p\n", (void *)conn);
}

/* Remote controller functions */

int send_saadc_notification(struct bt_conn *conn, uint32_t value, uint16_t length) {
    int err = 0;

    struct bt_gatt_notify_params params = {0};
    const struct bt_gatt_attr *attr = &remote_srv.attrs[2];

    params.attr = attr;
    params.data = &value;
    params.len = length;
    params.func = on_sent;

    err = bt_gatt_notify_cb(conn, &params);

    return err;
}

void set_saadc_value(uint32_t adc_value) {
    saadc_value = adc_value;
}

int bluetooth_init(struct bt_conn_cb *bt_cb, struct bt_remote_service_cb *remote_cb) {
    int err;
    printf("Initializing Bluetooth\n");

    if (bt_cb == NULL || remote_cb == NULL) {
        return NRFX_ERROR_NULL;
    }

    bt_conn_cb_register(bt_cb);
    remote_service_callbacks.notif_changed = remote_cb->notif_changed;

    err = bt_enable(bt_ready);
    if (err) {
        printf("bt_enable returned %d\n", err);
        return err;
    }

    k_sem_take(&bt_init_ok, K_FOREVER);

    return err;
}

int advertisment_init(void) {
    int err;
    printf("INIT ADVERTISMENT\n");

    err = bt_le_adv_start(BT_LE_ADV_CONN, ad, ARRAY_SIZE(ad), sd, ARRAY_SIZE(sd));
    if (err){
        printf("couldn't start advertising (err = %d)\n", err);
        return err;
    }

    return err;
}
```

## src/saadc.c
```c
#include "saadc.h"

float communicate_samples[NUM_SAMPLES][SAMPLE_SIZE];

nrf_saadc_value_t raw_samples[NUMBER_OF_CHANNELS];
nrfx_saadc_channel_t channels[NUMBER_OF_CHANNELS] = {
    NRFX_SAADC_DEFAULT_CHANNEL_SE(NRF_SAADC_INPUT_AIN0, 0), 
    NRFX_SAADC_DEFAULT_CHANNEL_SE(NRF_SAADC_INPUT_AIN1, 1) 
};
 
void handle_error(nrfx_err_t error_code) {
    if (error_code!= NRFX_SUCCESS)
    {
        printf("Error (0x%X)\n", error_code); 
    }
}

void saadc_init(void) {
    nrfx_err_t err_code;

    err_code = nrfx_saadc_init(NRFX_SAADC_DEFAULT_CONFIG_IRQ_PRIORITY);
    handle_error(err_code);
 
    err_code = nrfx_saadc_channels_config(channels, NUMBER_OF_CHANNELS);
    handle_error(err_code);

    err_code = nrfx_saadc_simple_mode_set((1<<0|1<<1),
                                      NRF_SAADC_RESOLUTION_12BIT,
                                      NRF_SAADC_OVERSAMPLE_DISABLED,
                                      NULL);
    handle_error(err_code);
}

void saadc_measure() {
    printk("START MEASURING\n");
    nrfx_err_t err_code;

    saadc_init();
    
    for (uint16_t i = 0; i < SAMPLE_SIZE; i++) {
        err_code = nrfx_saadc_buffer_set(raw_samples, NUMBER_OF_CHANNELS);
        handle_error(err_code);

        err_code = nrfx_saadc_mode_trigger();
        handle_error(err_code);

        communicate_samples[current_sample][i] = (raw_samples[0] * 3.6f * 1000) / 4095; // Changed gain in header file!

        printf("Measured value: %.2f mV\n", communicate_samples[current_sample][i]);     
    }
    printf("Current sample: %d\n", current_sample);
    current_sample += 1;

    // Uninint //
    nrfx_saadc_uninit();
    NRF_SAADC->INTENCLR = (SAADC_INTENCLR_END_Clear << SAADC_INTENCLR_END_Pos);
    NVIC_ClearPendingIRQ(SAADC_IRQn);
    // ---------------- //

    // SAADC reset - Workaround //
    volatile uint32_t temp1;
    volatile uint32_t temp2;
    volatile uint32_t temp3;

    temp1 = *(volatile uint32_t *)0x40007640ul;
    temp2 = *(volatile uint32_t *)0x40007644ul;
    temp3 = *(volatile uint32_t *)0x40007648ul;

    *(volatile uint32_t *)0x40007FFCul = 0ul;
    *(volatile uint32_t *)0x40007FFCul;
    *(volatile uint32_t *)0x40007FFCul = 1ul;

    *(volatile uint32_t *)0x40007640ul = temp1;
    *(volatile uint32_t *)0x40007644ul = temp2;
    *(volatile uint32_t *)0x40007648ul = temp3;
    // ---------------- //
}

void saadc_storage_check() {
    nrfx_err_t err_code;

    saadc_init();
    
    err_code = nrfx_saadc_buffer_set(raw_samples, NUMBER_OF_CHANNELS);
    handle_error(err_code);

    err_code = nrfx_saadc_mode_trigger();
    handle_error(err_code);

    // Uninint //
    nrfx_saadc_uninit();
    NRF_SAADC->INTENCLR = (SAADC_INTENCLR_END_Clear << SAADC_INTENCLR_END_Pos);
    NVIC_ClearPendingIRQ(SAADC_IRQn);
    // ---------------- //

    // SAADC reset - Workaround //
    volatile uint32_t temp1;
    volatile uint32_t temp2;
    volatile uint32_t temp3;

    temp1 = *(volatile uint32_t *)0x40007640ul;
    temp2 = *(volatile uint32_t *)0x40007644ul;
    temp3 = *(volatile uint32_t *)0x40007648ul;

    *(volatile uint32_t *)0x40007FFCul = 0ul;
    *(volatile uint32_t *)0x40007FFCul;
    *(volatile uint32_t *)0x40007FFCul = 1ul;

    *(volatile uint32_t *)0x40007640ul = temp1;
    *(volatile uint32_t *)0x40007644ul = temp2;
    *(volatile uint32_t *)0x40007648ul = temp3;
    // ---------------- //

    float storage_current = (raw_samples[1] * 3.6f * 1000) / 4095; // Changed gain in header file!
    printf("Stored current: %.2f mV - STATE: %d\n", storage_current, current_state);

    if (storage_current < SLEEP_THRESHOLD) {
        printf("Current too low, checkpoint.\n");
        current_state = DEEP_SLEEP;
    } else if (current_state == MEASURE && storage_current >= SLEEP_THRESHOLD && current_sample == 10) {
        printf("Measure completed, COMMUNICATE.\n");
        current_sample = 0;
        current_state = COMMUNICATE;
    } else if (current_state == MEASURE && storage_current >= SLEEP_THRESHOLD && current_sample != 10) {
        printf("Measure completed, SLEEP.\n");
        current_state = SLEEP;
    }else if (current_state == COMMUNICATE && storage_current >= SLEEP_THRESHOLD) {
        printf("Communicate completed, SLEEP.\n");
        current_state = SLEEP;
    }
}
```

## src/saadc.h
```c
#ifndef SAADC_H
#define SAADC_H

#include <zephyr/kernel.h>
#include <stdio.h>
#include <stdbool.h>
#include <stdint.h>
#include <nrfx_saadc.h>
#include <nrfx_timer.h>

#define NUMBER_OF_CHANNELS 2

#define SLEEP_THRESHOLD 1000 // mV
#define WAKE_UP_THRESHOLD 1500 // mV
#define NUM_SAMPLES 10
#define SAMPLE_SIZE 10

typedef enum {
    MEASURE,
    COMMUNICATE,
    DEEP_SLEEP,
    RECOVER,
    SLEEP,
} device_state_t;

extern device_state_t current_state;
extern device_state_t next_state;
extern float communicate_samples[NUM_SAMPLES][SAMPLE_SIZE];
extern uint32_t current_sample;

void handle_error(nrfx_err_t error_code);

void saadc_init(void);

void saadc_measure(void);

void saadc_storage_check(void);

#endif
```
