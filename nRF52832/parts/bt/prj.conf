## CMakeLists.txt
```
cmake_minimum_required(VERSION 3.20.0)
find_package(Zephyr REQUIRED HINTS $ENV{ZEPHYR_BASE})

project(bt)

FILE(GLOB app_sources src/*.c)
target_sources(app PRIVATE ${app_sources})
```

## prj.conf
```kconfig
CONFIG_BT=y
CONFIG_BT_PERIPHERAL=y
CONFIG_BT_DEVICE_NAME="SAADC - Bluetooth"
CONFIG_BT_DEVICE_APPEARANCE=0
CONFIG_BT_MAX_CONN=1
CONFIG_BT_LL_SOFTDEVICE=y

CONFIG_FPU=y

CONFIG_GPIO=y
```

## src/main.c
```c
#include "bt.h"
#include "nrfx_gpiote.h"

#define GPIO_PIN 15

int main(void) {
    nrfx_err_t err_code = nrfx_gpiote_init(3);
    if (err_code != NRFX_SUCCESS){
        printf("Error (0x%X)\n", err_code); 
    }

    nrfx_gpiote_output_config_t out_config = NRFX_GPIOTE_DEFAULT_OUTPUT_CONFIG;
    
    err_code = nrfx_gpiote_output_configure(GPIO_PIN, &out_config, NULL);
    if (err_code != NRFX_SUCCESS){
        printf("Error (0x%X)\n", err_code); 
    }

    int err;

    printf("Starting BT service test...\n");

    fill_saadc_values();

    err = bluetooth_init(&bluetooth_callbacks, &remote_service_callbacks);
    if (err) {
        printf("Couldn't initialize Bluetooth. err: %d", err);
    }

    advertisment_init();

    k_sleep(K_SECONDS(3));
    //k_sleep(K_MSEC(150));

    nrfx_gpiote_out_set(GPIO_PIN);
    saadc_handler();
    nrfx_gpiote_out_clear(GPIO_PIN);

    advertisment_uninit();
    
    printf("BT service test completed.\n");
}
```

## src/bt.c
```c
#include "bt.h"

#define NUM_SAMPLES 100

float saadc_values[NUM_SAMPLES];
//int sample_index = 0;
//float measure_value = 521.34;

struct bt_conn *current_conn;

struct bt_conn_cb bluetooth_callbacks = {
	.connected 		= on_connected,
	.disconnected 	= on_disconnected,
};

struct bt_remote_service_cb remote_service_callbacks = {
    .notif_changed = on_notif_changed,
};

/* Callbacks */

void on_connected(struct bt_conn *conn, uint8_t err) {
	if(err) {
		printf("connection err: %d\n", err);
		return;
	}
	printf("Connected.\n");
	current_conn = bt_conn_ref(conn);
}

void on_disconnected(struct bt_conn *conn, uint8_t reason) {
	printf("Disconnected (reason: %d)\n", reason);
	if(current_conn) {
		bt_conn_unref(current_conn);
		current_conn = NULL;
	}
}

void on_notif_changed(enum bt_saadc_notifications_enabled status) {
    if (status == BT_SAADC_NOTIFICATIONS_ENABLED) {
        printf("Notifications enabled\n");
    } else {
        printf("Notifications disabled\n");
    }
}

void fill_saadc_values(void) {
    float base_value = 53.34; // Starting value for samples
    for (int i = 0; i < NUM_SAMPLES; i++) {
        saadc_values[i] = base_value + i; // Increment value for each sample
    }
}

void saadc_handler(void) {
    int err;

    if (!current_conn) {
        printf("No active connection to send notification.\n");
        return;
    }

    for (int i = 0; i < NUM_SAMPLES; ++i) {
        float value = saadc_values[i] * 100; 
        uint32_t value_int = (uint32_t)value;
        printf("Sending sample %d: %d\n", i, value_int);
        set_saadc_value(value_int);
        err = send_saadc_notification(current_conn, value_int, sizeof(value_int));
        if (err) {
            printf("Failed to send SAADC notification (Error: %d)\n", err);
        }
        k_sleep(K_MSEC(50));
    }
}

int advertisment_uninit(void) {
    printf("UNINIT ADVERTISMENT\n");

    if (current_conn) {
        int err = bt_conn_disconnect(current_conn, BT_HCI_ERR_REMOTE_USER_TERM_CONN);
        if (err) {
            printf("Disconnection failed (err %d)\n", err);
        }

        bt_conn_unref(current_conn);
        current_conn = NULL;
    }

    int err = bt_le_adv_stop();
    if (err) {
        printf("Stopping advertising failed (err %d)\n", err);
    }
    return err;
}
```

## src/bt.h
```c
#ifndef BT_H
#define BT_H

#include "remote.h"

/* Declarations */

void on_connected(struct bt_conn *conn, uint8_t err);
void on_disconnected(struct bt_conn *conn, uint8_t reason);
void on_notif_changed(enum bt_saadc_notifications_enabled status);
void fill_saadc_values(void);
void saadc_handler(void);
int advertisment_uninit(void);

extern struct bt_conn_cb bluetooth_callbacks;
extern struct bt_remote_service_cb remote_service_callbacks;

#endif
```

## src/remote.h
```c
#ifndef REMOTE_H
#define REMOTE_H

#include <zephyr/kernel.h>

#include <zephyr/bluetooth/bluetooth.h>
#include <zephyr/bluetooth/uuid.h>
#include <zephyr/bluetooth/gatt.h>
#include <zephyr/bluetooth/hci.h>

/** @brief UUID of the Remote Service. **/
#define BT_UUID_REMOTE_SERV_VAL \
	BT_UUID_128_ENCODE(0xe9ea0001, 0xe19b, 0x482d, 0x9293, 0xc7907585fc48)

/** @brief UUID of the SAADC Characteristic. **/
#define BT_UUID_REMOTE_SAADC_CHRC_VAL \
	BT_UUID_128_ENCODE(0xe9ea0002, 0xe19b, 0x482d, 0x9293, 0xc7907585fc48)

#define BT_UUID_REMOTE_SERVICE          BT_UUID_DECLARE_128(BT_UUID_REMOTE_SERV_VAL)
#define BT_UUID_REMOTE_SAADC_CHRC 		BT_UUID_DECLARE_128(BT_UUID_REMOTE_SAADC_CHRC_VAL)

enum bt_saadc_notifications_enabled {
	BT_SAADC_NOTIFICATIONS_ENABLED,
	BT_SAADC_NOTIFICATIONS_DISABLED,
};

struct bt_remote_service_cb {
	void (*notif_changed)(enum bt_saadc_notifications_enabled status);
};

int send_saadc_notification(struct bt_conn *conn, uint32_t value, uint16_t length);
void set_saadc_value(uint32_t adc_value);
int bluetooth_init(struct bt_conn_cb *bt_cb, struct bt_remote_service_cb *remote_cb);
int advertisment_init(void); 

#endif
```
