## CMakeLists.txt
```
cmake_minimum_required(VERSION 3.20.0)
find_package(Zephyr REQUIRED HINTS $ENV{ZEPHYR_BASE})

project(adc_multi)

FILE(GLOB app_sources src/*.c)
target_sources(app PRIVATE ${app_sources})
```

## prj.conf
```kconfig
CONFIG_NRFX_SAADC=y
```

## src/main.c
```c
#include "saadc.h"
#include "nrfx_gpiote.h"
#include <zephyr/kernel.h>

#define GPIO_PIN 15

int main(void) {
    nrfx_err_t err_code = nrfx_gpiote_init(3);
    if (err_code != NRFX_SUCCESS){
        printf("Error (0x%X)\n", err_code); 
    }

    nrfx_gpiote_output_config_t out_config = NRFX_GPIOTE_DEFAULT_OUTPUT_CONFIG;
    
    err_code = nrfx_gpiote_output_configure(GPIO_PIN, &out_config, NULL);
    if (err_code != NRFX_SUCCESS){
        printf("Error (0x%X)\n", err_code); 
    }

    nrfx_gpiote_out_set(GPIO_PIN);
    saadc_init();
    nrfx_gpiote_out_clear(GPIO_PIN);
    k_sleep(K_SECONDS(1));

    // Continuously measure for a fixed duration (10 seconds)
    uint32_t start_time = k_uptime_get_32();
    while (k_uptime_get_32() - start_time < 10000) {
        nrfx_gpiote_out_set(GPIO_PIN);
        saadc_measure();
        nrfx_gpiote_out_clear(GPIO_PIN);
        k_sleep(K_MSEC(100));
    }

    printf("SAADC service test completed.\n");
}
```

## src/saadc.c
```c
#include "saadc.h"

float measure_value;

nrf_saadc_value_t samples[NUMBER_OF_CHANNELS];
nrfx_saadc_channel_t channels[NUMBER_OF_CHANNELS] = 
{
    NRFX_SAADC_DEFAULT_CHANNEL_SE(NRF_SAADC_INPUT_AIN0, 0), 
    NRFX_SAADC_DEFAULT_CHANNEL_SE(NRF_SAADC_INPUT_AIN1, 1) 
};
 
void handle_error(nrfx_err_t error_code)
{
    if (error_code!= NRFX_SUCCESS)
    {
        printf("Error (0x%X)\n", error_code); 
    }
}

void saadc_init(void)
{
    nrfx_err_t err_code;

    err_code = nrfx_saadc_init(NRFX_SAADC_DEFAULT_CONFIG_IRQ_PRIORITY);
    handle_error(err_code);
 
    err_code = nrfx_saadc_channels_config(channels, NUMBER_OF_CHANNELS);
    handle_error(err_code);

    err_code = nrfx_saadc_simple_mode_set((1<<0|1<<1),
                                      NRF_SAADC_RESOLUTION_12BIT,
                                      NRF_SAADC_OVERSAMPLE_DISABLED,
                                      NULL);
    handle_error(err_code);
}

void saadc_measure() {
    nrfx_err_t err_code;
 
    err_code = nrfx_saadc_buffer_set(samples, NUMBER_OF_CHANNELS);
    handle_error(err_code);

    err_code = nrfx_saadc_mode_trigger();
    handle_error(err_code);

    measure_value = (samples[0] * 3.6f * 1000) / 4095; // Changed gain in header file!
    printf("Measured value: %.2f V\n", measure_value);
}

void saadc_storage_check() {
    nrfx_err_t err_code;
 
    err_code = nrfx_saadc_buffer_set(samples, NUMBER_OF_CHANNELS);
    handle_error(err_code);

    err_code = nrfx_saadc_mode_trigger();
    handle_error(err_code);

    float storage_current = (samples[1] * 3.6f * 1000) / 4095; // Changed gain in header file!
    printf("Stored current: %.2f mV - STATE: %d\n", storage_current, current_state);

    if (current_state == MEASURE && storage_current < SLEEP_THRESHOLD) {
        printf("Current too low, going to SAVE.\n");
        current_state = SAVE;
    } else if (current_state == COMMUNICATE && storage_current < SLEEP_THRESHOLD) {
        printf("Current too low, going to SAVE.\n");
        current_state = SAVE;
    } else if (current_state == MEASURE && storage_current >= SLEEP_THRESHOLD) {
        printf("Measure completed, going to COMMUNICATE.\n");
        current_state = COMMUNICATE;
    } else if (current_state == COMMUNICATE && storage_current >= SLEEP_THRESHOLD) {
        printf("Communicate completed, going to NORMAL_SLEEP.\n");
        current_state = NORMAL_SLEEP;
    }
}
```

## src/saadc.h
```c
#ifndef SAADC_H
#define SAADC_H

#include <zephyr/kernel.h>
#include <stdio.h>
#include <stdbool.h>
#include <stdint.h>
#include <nrfx_saadc.h>
#include <nrfx_timer.h>

#define NUMBER_OF_CHANNELS 2

#define SLEEP_THRESHOLD 1000 // mV
#define WAKE_UP_THRESHOLD 1500 // mV

typedef enum {
    MEASURE,
    COMMUNICATE,
    SAVE,
    RECOVER,
    NORMAL_SLEEP,
    THRESHOLD_SLEEP,
} device_state_t;

extern device_state_t current_state;

void handle_error(nrfx_err_t error_code);

void saadc_init(void);

void saadc_measure(void);

void saadc_storage_check(void);

void test_saadc_service(void);

#endif
```
