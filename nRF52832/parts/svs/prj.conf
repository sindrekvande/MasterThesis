## CMakeLists.txt
```
cmake_minimum_required(VERSION 3.20.0)
find_package(Zephyr REQUIRED HINTS $ENV{ZEPHYR_BASE})

project(svs)

FILE(GLOB app_sources src/*.c)
target_sources(app PRIVATE ${app_sources})
```

## prj.conf
```kconfig
CONFIG_NRFX_POWER=y
CONFIG_GPIO=y
```

## src/main.c
```c
#include "svs.h"
#include "nrfx_gpiote.h"
#include <zephyr/kernel.h>

#define GPIO_PIN 15

int main() {
    nrfx_err_t err_code = nrfx_gpiote_init(3);
    if (err_code != NRFX_SUCCESS){
        printf("Error (0x%X)\n", err_code); 
    }

    nrfx_gpiote_output_config_t out_config = NRFX_GPIOTE_DEFAULT_OUTPUT_CONFIG;
    
    err_code = nrfx_gpiote_output_configure(GPIO_PIN, &out_config, NULL);
    if (err_code != NRFX_SUCCESS){
        printf("Error (0x%X)\n", err_code); 
    }
    k_sleep(K_SECONDS(1));
    nrfx_gpiote_out_set(GPIO_PIN);
    svs_init();
    nrfx_gpiote_out_clear(GPIO_PIN);
}
```

## src/svs.c
```c
#include <nrfx_power.h>
#include "svs.h"
#include <stdio.h>

void svs_init() {
    printf("SVS INIT\n");

    nrfx_power_pofwarn_config_t pof_config = {
        .thr = NRF_POWER_POFTHR_V18,
        .handler = svs_handler
    };

    nrfx_power_pof_init(&pof_config);

    nrfx_power_pof_enable(&pof_config);
}

void svs_handler() {
    printf("SVS HANDLER\n");
}
```

## src/svs.h
```c
void svs_init(void);
void svs_handler(void);
```
